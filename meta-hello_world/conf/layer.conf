## meta-hello_world/conf/layer.conf
```bitbake
# We have a conf and classes directory, add to BBPATH
BBPATH .= ":${LAYERDIR}"

# We have recipes-* directories, add to BBFILES
BBFILES += "${LAYERDIR}/recipes-*/*/*.bb \
            ${LAYERDIR}/recipes-*/*/*.bbappend"

BBFILE_COLLECTIONS += "../meta-hello_world"
BBFILE_PATTERN_../meta-hello_world = "^${LAYERDIR}/"
BBFILE_PRIORITY_../meta-hello_world = "6"
```

## meta-self/conf/layer.conf
```bitbake
# We have a conf and classes directory, add to BBPATH
BBPATH .= ":${LAYERDIR}"

# We have recipes-* directories, add to BBFILES
BBFILES += "${LAYERDIR}/recipes-*/*/*.bb \
            ${LAYERDIR}/recipes-*/*/*.bbappend"

BBFILE_COLLECTIONS += "../meta-self"
BBFILE_PATTERN_../meta-self = "^${LAYERDIR}/"
BBFILE_PRIORITY_../meta-self = "6"
```
